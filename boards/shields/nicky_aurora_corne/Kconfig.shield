## boards/shields/nicky_aurora_corne/Kconfig.shield
```kconfig
# Copyright (c) 2022 The ZMK Contributors
# SPDX-License-Identifier: MIT

config SHIELD_NICKY_AURORA_CORNE_LEFT
    def_bool $(shields_list_contains,nicky_aurora_corne_left)

config SHIELD_NICKY_AURORA_CORNE_RIGHT
    def_bool $(shields_list_contains,nicky_aurora_corne_right)
```
